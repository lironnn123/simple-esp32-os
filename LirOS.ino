#include <Wire.h>
#include <Adafruit_GFX.h>
#include <Adafruit_SSD1306.h>

const int screenSizeX = 128;
const int screenSizeY = 64;

Adafruit_SSD1306 screen(screenSizeX, screenSizeY, &Wire, -1);

const int buttonAmount = 5;
const int buttonPins[buttonAmount] = {15, 5, 4, 16, 17};
bool buttonPress[buttonAmount] = {false, false, false, false, false};
bool buttonHold[buttonAmount] = {false, false, false, false, false};
bool buttonPushed[buttonAmount] = {false, false, false, false, false};
unsigned long buttonPushStart[5] = {0, 0, 0, 0, 0};

int timeSeconds = 0;
int timeMinutes = 0;
int timeHours = 0;
unsigned long lastSecondIncrease = 0;
bool realTime = false;
char timeStr[16];

bool home = true;
const int homePageAmount = 2;
int homePage = 0;
const int appsAmount = 5;
const int appsPerPage = 2;
const int pagesAmount = (appsAmount + 1) / appsPerPage;
int selectedApp = 1;
int selectedPage = 1;
int pageApp[appsPerPage] = {1, 2};
String appNames[appsAmount + 1] = {"none", "Settings", "Clock", "Calculator", "app4", "app5"};
int openedApp = 0;

const int settingsAmount = 3;
int selectedSetting = 0;
int settingsSelected[settingsAmount] = {0, 0, 0};
const String settingNames[settingsAmount] = {"Time", "test", "test"};
const int settingOptionsAmount[settingsAmount] = {3, 4, 4};
const String timeDisplayOptions[3] = {"HH:MM:SS", "HH:MM", "MM:SS"};
const String test1Options[4] = {"1", "2", "3", "4"};
const String test2Options[4] = {"1", "2", "3", "4"};
const String* settingsOptions[settingsAmount] = {timeDisplayOptions, test1Options, test2Options};

const int settingsIcon[] = {
  0,0,0,0,0,0,0,0,0,0,0,0,0,0,0,0,0,0,0,0,0,0,0,0,0,0,0,0,0,0,0,0,0,0,0,0,0,0,0,0,0,0,0,0,0,0,0,0,
  0,0,0,0,0,0,0,0,0,0,0,0,0,0,0,0,0,0,0,0,0,0,0,0,0,0,0,0,0,0,0,0,0,0,0,0,0,0,0,0,0,0,0,0,0,0,0,0,
  0,0,0,0,0,0,0,0,0,0,0,0,0,0,0,0,0,0,0,0,0,0,0,0,0,0,0,0,0,0,0,0,0,0,0,0,0,0,0,0,0,0,0,0,0,0,0,0,
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  0,0,0,0,0,0,0,0,0,0,0,0,0,0,0,0,0,0,0,0,0,0,0,0,0,0,0,0,0,0,0,0,0,0,0,0,0,0,0,0,0,0,0,0,0,0,0,0
};

const int clockIcon[] = {
  0,0,0,0,0,0,0,0,0,0,0,0,0,0,0,0,0,0,0,0,0,0,0,0,0,0,0,0,0,0,0,0,0,0,0,0,0,0,0,0,0,0,0,0,0,0,0,0,
  0,0,0,0,0,0,0,0,0,0,0,0,0,0,0,0,0,0,0,0,0,0,0,0,0,0,0,0,0,0,0,0,0,0,0,0,0,0,0,0,0,0,0,0,0,0,0,0,
  0,0,0,0,0,0,0,0,0,0,0,0,0,0,0,0,0,0,0,0,0,0,0,0,0,0,0,0,0,0,0,0,0,0,0,0,0,0,0,0,0,0,0,0,0,0,0,0,
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  0,0,0,0,0,0,0,0,0,0,0,0,0,0,0,0,0,0,0,0,0,0,0,0,0,0,0,0,0,0,0,0,0,0,0,0,0,0,0,0,0,0,0,0,0,0,0,0
};

const int calculatorIcon[] = {
  0,0,0,0,0,0,0,0,0,0,0,0,0,0,0,0,0,0,0,0,0,0,0,0,0,0,0,0,0,0,0,0,0,0,0,0,0,0,0,0,0,0,0,0,0,0,0,0,
  0,0,0,0,0,0,0,0,0,0,0,0,0,0,0,0,0,0,0,0,0,0,0,0,0,0,0,0,0,0,0,0,0,0,0,0,0,0,0,0,0,0,0,0,0,0,0,0,
  0,0,0,0,0,0,0,0,0,0,0,0,0,0,0,0,0,0,0,0,0,0,0,0,0,0,0,0,0,0,0,0,0,0,0,0,0,0,0,0,0,0,0,0,0,0,0,0,
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  0,0,0,0,0,0,0,0,0,0,0,0,0,0,0,0,0,0,0,0,0,0,0,0,0,0,0,0,0,0,0,0,0,0,0,0,0,0,0,0,0,0,0,0,0,0,0,0
};

const int comingSoonIcon[] = {
  0,0,0,0,0,0,0,0,0,0,0,0,0,0,0,0,0,0,0,0,0,0,0,0,0,0,0,0,0,0,0,0,0,0,0,0,0,0,0,0,0,0,0,0,0,0,0,0,
  0,0,0,0,0,0,0,0,0,0,0,0,0,0,0,0,0,0,0,0,0,0,0,0,0,0,0,0,0,0,0,0,0,0,0,0,0,0,0,0,0,0,0,0,0,0,0,0,
  0,0,0,0,0,0,0,0,0,0,0,0,0,0,0,0,0,0,0,0,0,0,0,0,0,0,0,0,0,0,0,0,0,0,0,0,0,0,0,0,0,0,0,0,0,0,0,0,
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  0,0,0,0,0,0,0,0,0,0,0,0,0,0,0,0,0,0,0,0,0,0,0,0,0,0,0,0,0,0,0,0,0,0,0,0,0,0,0,0,0,0,0,0,0,0,0,0
};

const int* appIcons[appsAmount + 1] = {nullptr, settingsIcon, clockIcon, calculatorIcon, comingSoonIcon, comingSoonIcon};

const int iconSizeW = 48;
const int iconSizeH = 48;

void setup() {
  Wire.begin(21, 22);

  screen.begin(SSD1306_SWITCHCAPVCC, 0x3C);
  screen.clearDisplay();

  for(int i = 0; i < 5; i++) pinMode(buttonPins[i], INPUT_PULLUP);
}

void loop() {
  buttonUpdate();

  screen.clearDisplay();
  screen.setTextColor(WHITE);

  updateTime();

  if(home) {
    homeScreen(); 
  }

  if(openedApp > 0) {
    appOpen();
  }
  
  if(buttonHold[4]) {
    goHome();
  }

  screen.display();

  resetButtons();
}

void buttonUpdate() {
  for(int i = 0; i < buttonAmount; i++) {
    buttonPushed[i] = digitalRead(buttonPins[i]) == LOW;

    if(buttonPushed[i] && buttonPushStart[i] == 0) buttonPushStart[i] = millis();

    if(!buttonPushed[i] && buttonPushStart[i] != 0) {
      if(millis() - buttonPushStart[i] >= 500) buttonHold[i] = true;
      else buttonPress[i] = true;
      buttonPushStart[i] = 0;
    }
  }
}

void updateTime() {
  realTime = false;

  if(millis() - lastSecondIncrease >= 1000) {
    lastSecondIncrease = millis(); 
    timeSeconds ++;
  }
  if(timeSeconds == 60) {
    timeSeconds = 0;
    timeMinutes ++;
  }
  if(timeMinutes == 60) {
    timeMinutes = 0;
    timeHours ++;
  }
  if(timeHours == 24) {
    timeHours = 0;
  }

  if(settingsSelected[0] == 0) sprintf(timeStr, "%02d:%02d:%02d", timeHours, timeMinutes, timeSeconds);
  if(settingsSelected[0] == 1) sprintf(timeStr, "%02d:%02d", timeHours, timeMinutes);
  if(settingsSelected[0] == 2) sprintf(timeStr, "%02d:%02d", timeMinutes, timeSeconds);


  if(homePage > 0) {
    screen.setTextSize(1);
    screen.setCursor((screenSizeX - strlen(timeStr) * 6) / 2, 0);
    screen.print(timeStr);
  }
}

void homeScreen() {
  if(buttonPress[1] && homePage < homePageAmount - 1) {
    homePage ++;
  }

  if(buttonPress[3] && homePage > 0) {
    homePage --;
  }

  if(homePage == 0) {
    screen.setTextSize(2);
    screen.setCursor((screenSizeX - strlen(timeStr) * 12) / 2, (screenSizeY - 16) / 2);
    screen.print(timeStr);
  }

  if(homePage == 1) {
    if(buttonPress[0]) {
      if(selectedApp < appsAmount) {
        if(selectedApp == pageApp[1]) selectedPage ++;
        selectedApp ++;
      }
      else {
        selectedApp = 1;
        selectedPage = 1;
      }
    }
  
    if(buttonPress[2]) {
      if(selectedApp > 1) {
        if(selectedApp == pageApp[0]) selectedPage --;
        selectedApp --;
      }
      else {
        selectedApp = appsAmount;
        selectedPage = pagesAmount;
      }
    }

    if(buttonPress[4]) {
      openedApp = selectedApp;
      home = false;
    }

    pageApp[0] = selectedPage * 2 - 1;
    pageApp[1] = selectedPage * 2;
    if(pageApp[1] > appsAmount) pageApp[1] = 0;

    for(int i = 0; i < 2; i++){
      if(pageApp[i] > 0) {
        if(selectedApp == pageApp[i]) {
          drawBitmap(screenSizeX / 16 + screenSizeX / 2 * (i), screenSizeY / 8, iconSizeW, iconSizeH, appIcons[pageApp[i]], true);
        }
        else {
          drawBitmap(screenSizeX / 16 + screenSizeX / 2 * (i), screenSizeY / 8, iconSizeW, iconSizeH, appIcons[pageApp[i]], false);
        }
      }
    }
  }
}

void appOpen() {
  screen.setTextSize(1);
  screen.setCursor(0, 0);
  screen.println();
  screen.println(appNames[openedApp]);

  if(openedApp == 1) settingsApp();
}

void settingsApp() {
  if(buttonPress[3]) {
    selectedSetting --;
    if(selectedSetting < 0) selectedSetting = settingsAmount - 1;
  }

  if(buttonPress[1]) {
    selectedSetting ++;
    if(selectedSetting == settingsAmount) selectedSetting = 0;
  }

  if(buttonPress[0]) {
    settingsSelected[selectedSetting] ++;
    if(settingsSelected[selectedSetting] == settingOptionsAmount[selectedSetting]) settingsSelected[selectedSetting] = 0;
  }

  if(buttonPress[2]) {
    settingsSelected[selectedSetting] --;
    if(settingsSelected[selectedSetting] < 0) settingsSelected[selectedSetting] = settingOptionsAmount[selectedSetting] - 1;
  }

  for(int i = 0; i < settingsAmount; i++) {
    screen.print(settingNames[i]);
    screen.print(":");
    if(i == selectedSetting) screen.print("< "); else screen.print("  ");
    screen.print(settingsOptions[i][settingsSelected[i]]);
    if(i == selectedSetting) screen.println(" >"); else screen.println("  ");
  }
}

void goHome() {
  selectedPage = 1;
  selectedApp = 1;
  home = true;
  homePage = 0;
  openedApp = 0;

  selectedSetting = 0;
}

void resetButtons() {
  for(int i = 0; i < buttonAmount; i++) {
    buttonPress[i] = false;
    buttonHold[i] = false;
  }
}

void drawBitmap(int x, int y, int w, int h, const int* bitmap, bool revert) {
  for(int i = 0; i < h; i++) {
    for(int j = 0; j < w; j++) {
      int pixel = bitmap[i * w + j];

      if(revert) pixel = !pixel;

      if(pixel == 1) screen.drawPixel(x + j, y + i, WHITE);
    }
  }
}
